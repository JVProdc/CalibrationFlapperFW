## configs/bolt_defconfig
```kconfig
CONFIG_PLATFORM_BOLT=y

CONFIG_ESTIMATOR_AUTO_SELECT=y
CONFIG_CONTROLLER_AUTO_SELECT=y

CONFIG_DECK_FORCE="bcLedRing"

CONFIG_MOTORS_REQUIRE_ARMING=y
CONFIG_DECK_LEDRING_DEFAULT_EFFECT=19
CONFIG_DECK_LEDRING_NBR_LEDS=8
```
